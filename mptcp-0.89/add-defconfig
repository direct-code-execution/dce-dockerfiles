## mptcp-0.89/add-defconfig
```kconfig
CONFIG_MPTCP=y
CONFIG_MPTCP_PM_ADVANCED=y
CONFIG_MPTCP_FULLMESH=y
CONFIG_MPTCP_NDIFFPORTS=y
CONFIG_DEFAULT_FULLMESH=y
CONFIG_DEFAULT_MPTCP_PM="fullmesh"
CONFIG_TCP_CONG_COUPLED=y
CONFIG_TCP_CONG_OLIA=y
```
